## drivers/bsp_driver/Kconfig
```kconfig
#
# Bsp Driver Debug subsystem configuration
#

menuconfig BSP_DEBUG
	tristate "Bsp Driver Debug Support"
	---help---
	  Bsp Driver Debug Support.

if BSP_DEBUG

source "drivers/bsp_driver/gpio_debug/Kconfig"

endif # BSP_DEBUG
```

## drivers/input/belasigna/Kconfig
```kconfig
config BELASIGNA_BS300
	bool "BELASIGNA BS300 AUDIO"	
	depends on GPIO_I2C_ADPT
	help
	  Say Y here if you have the BELASIGNA BS300. 
```

## drivers/input/cypress_120/Kconfig
```kconfig
#
# touch panel driver configuration
#
menuconfig INPUT_CYPRESS120_I2C_TS
	bool "cypress120-i2c-touchscreen"
	default y
	help
	  Say Y here, and a list of supported Cypress 120 TS will be displayed.
	  This option doesn't affect the kernel.

	 

if INPUT_CYPRESS120_I2C_TS

config CYPRESS120
	tristate "cypress120-i2c-touchscreen"	
	default y
	select SERIO
	help
	  Say Y here if you have the cypress120 ts.
endif
	 
 
```

## drivers/input/dock/Kconfig
```kconfig
#
# dock driver configuration
#

config DOCK_DET
	bool "Dock detect"	
	default n
	help
	  Say Y here if you want to detect dock.
```

## drivers/input/pedestal/Kconfig
```kconfig
#
# accelerometer driver configuration
#
menuconfig INPUT_PEDESTAL
	bool "Pedestal"
	help
	  Say Y here, and a list of supported Pedestal will be displayed.
	  This option doesn't affect the kernel.

	 

if INPUT_PEDESTAL

config PEDESTAL
	tristate "Pedestal"	
	select SERIO
	help
	  Say Y here if you have the Pedestal.
endif
	 
 
```

## drivers/video/msm/Kconfig
```kconfig
config FB_MSM
	tristate
	depends on FB && ARCH_MSM
	select FB_CFB_FILLRECT
	select FB_CFB_COPYAREA
	select FB_CFB_IMAGEBLIT
	default y

config FB_MSM_LCDC
	bool "Support for integrated LCD controller in qsd8x50"
	depends on FB_MSM && MSM_MDP31
	default y

#
# HDMI Configuration
#
config MSM_HDMI
	tristate "MSM HDMI"
	depends on MACH_QSD8X50_SURF_S70
	help
	  MSM/QSD HDMI controller.

config MSM_HDMI_POWER_OFF_WHEN_LP
	bool "Power off when disable HDMI"
	depends on MSM_HDMI
	help
	  Power off when disable HDMI

config MSM_FB_RGB565
	tristate "MSM FB RGB565"
	default n
	help
	  MSM/QSD FB controller.
```
